/*
 * SPDX-FileCopyrightText: Copyright (C) 2024 Intel Corporation
 * SPDX-License-Identifier: MIT-0
 */

/dts-v1/;
/plugin/;
/ {
	fragment@0 {
		target-path = "/soc/base_fpga_region";
		__overlay__ {
			firmware-name = "hw_uart.rbf";
			config-complete-timeout-us = <30000000>;
		};
	};
	fragment@1 {
		target-path = "/soc/serial@10c02000";
		__overlay__ {
			status = "okay";
		};
	};
/*
	fragment@2 {
		target-path = "/aliases";
		__overlay__ {
			serial1 = "/soc/serial@10c02000";
		};
	};
*/
};

