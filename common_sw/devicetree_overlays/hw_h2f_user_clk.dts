/*
 * SPDX-FileCopyrightText: Copyright (C) 2024 Intel Corporation
 * SPDX-FileCopyrightText: Copyright (C) 2025 Altera Corporation
 * SPDX-License-Identifier: MIT-0
 */

/dts-v1/;
/plugin/;
/ {
	fragment@0 {
		target-path = "/fpga-region";
		__overlay__ {
			firmware-name = "hw_h2f_user_clk.rbf";
			config-complete-timeout-us = <30000000>;
		};
	};
};

