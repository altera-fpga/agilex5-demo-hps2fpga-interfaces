/*
 * SPDX-FileCopyrightText: Copyright (C) 2024 Intel Corporation
 * SPDX-License-Identifier: MIT-0
 */

/dts-v1/;
/plugin/;
/ {
	fragment@0 {
		target-path = "/soc@0/base_fpga_region";
		__overlay__ {
			firmware-name = "hw_lwh2f_bridge.rbf";
			config-complete-timeout-us = <30000000>;
		};
	};
	fragment@1 {
		target-path = "/";
		__overlay__ {
			#address-cells = <0x2>;
			#size-cells = <0x2>;

			lwh2f-bridge@20000000 {
				compatible = "no-pins,demo";
				reg = <0 0x20000000 0 0x20000000>;
				reg-names = "lwh2f-bridge";
				linux,uio-name = "lwh2f-bridge-uio";
			};
		};
	};
};

