/*
 * SPDX-FileCopyrightText: Copyright (C) 2024 Intel Corporation
 * SPDX-License-Identifier: MIT-0
 */

/dts-v1/;
/plugin/;
/ {
	fragment@0 {
		target-path = "/soc@0/base_fpga_region";
		__overlay__ {
			firmware-name = "hw_hps_gp.rbf";
			config-complete-timeout-us = <30000000>;
		};
	};
};

